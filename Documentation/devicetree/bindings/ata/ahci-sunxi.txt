## Documentation/devicetree/bindings/ata/ahci-sunxi.txt
```
Allwinner SUNXI AHCI SATA Controller

SATA nodes are defined to describe on-chip Serial ATA controllers.
Each SATA controller should have its own node.

Required properties:
- compatible	: compatible list, contains "allwinner,sun4i-a10-ahci"
- reg		: <registers mapping>
- interrupts	: <interrupt mapping for AHCI IRQ>
- clocks	: clocks for ACHI
- clock-names	: clock names for AHCI

Optional properties:
- pwr-supply	: regulator to control the power supply GPIO

Example:
	ahci@01c18000 {
		compatible = "allwinner,sun4i-a10-ahci";
		reg = <0x01c18000 0x1000>;
		interrupts = <0 56 1>;
		clocks = <&ahb_gates 25>, <&pll6 0>;
		clock-names = "ahb_sata", "pll6_sata";
		pwr-supply = <&reg_ahci_5v>;
	};
```

## Documentation/devicetree/bindings/mtd/partition.txt
```
Flash partitions in device tree
===============================

Flash devices can be partitioned into one or more functional ranges (e.g.,
"boot code", "nvram", and "kernel") in at least two distinct ways:

 (A) a fixed flash layout at production time or
 (B) with an on-flash partition table, such as RedBoot, that describes the
     geometry and naming/purpose of each functional region

The former typically requires an operating system to learn about the
partitioning from some kind of metadata provided by the bootloader/firmware.
Such partitions can be described using the method in "Section A: Fixed Partitions".

The latter is somewhat analogous to partition tables used on block devices
(e.g., MBR or GPT), except that there is less standardization for flash
devices, and it is not always safe or efficient to attempt to search for all of
them on every flash device in the system, particularly since many of them allow
their data structures to be placed anywhere on the flash, and so require
scanning the entire flash device to find them.

To assist system software in locating these partition tables, we provide a
binding to describe which partition format(s) may be used on a given flash,
found below in "Section B: On-Flash Partition Tables".


Section A: Fixed Partitions
---------------------------

Partitions can be represented by sub-nodes of a flash device. This can be used
on platforms which have strong conventions about which portions of a flash are
used for what purposes, but which don't use an on-flash partition table such
as RedBoot.

The partition table should be a subnode of the flash node and should be named
'partitions'. This node should have the following property:
- compatible : (required) must be "partitions"
Partitions are then defined in subnodes of the partitions node.

For backwards compatibility partitions as direct subnodes of the flash device are
supported. This use is discouraged.
NOTE: also for backwards compatibility, direct subnodes that have a compatible
string are not considered partitions, as they may be used for other bindings.

#address-cells & #size-cells must both be present in the partitions subnode of the
flash device. There are two valid values for both:
<1>: for partitions that require a single 32-bit cell to represent their
     size/address (aka the value is below 4 GiB)
<2>: for partitions that require two 32-bit cells to represent their
     size/address (aka the value is 4 GiB or greater).

Required properties:
- reg : The partition's offset and size within the flash

Optional properties:
- label : The label / name for this partition.  If omitted, the label is taken
  from the node name (excluding the unit address).
- read-only : This parameter, if present, is a hint to Linux that this
  partition should only be mounted read-only. This is usually used for flash
  partitions containing early-boot firmware images or data which should not be
  clobbered.
- lock : Do not unlock the partition at initialization time (not supported on
  all devices)

Examples:


flash@0 {
	partitions {
		compatible = "partitions";
		#address-cells = <1>;
		#size-cells = <1>;

		partition@0 {
			label = "u-boot";
			reg = <0x0000000 0x100000>;
			read-only;
		};

		uimage@100000 {
			reg = <0x0100000 0x200000>;
		};
	};
};

flash@1 {
	partitions {
		compatible = "partitions";
		#address-cells = <1>;
		#size-cells = <2>;

		/* a 4 GiB partition */
		partition@0 {
			label = "filesystem";
			reg = <0x00000000 0x1 0x00000000>;
		};
	};
};

flash@2 {
	partitions {
		compatible = "partitions";
		#address-cells = <2>;
		#size-cells = <2>;

		/* an 8 GiB partition */
		partition@0 {
			label = "filesystem #1";
			reg = <0x0 0x00000000 0x2 0x00000000>;
		};

		/* a 4 GiB partition */
		partition@200000000 {
			label = "filesystem #2";
			reg = <0x2 0x00000000 0x1 0x00000000>;
		};
	};
};


Section B: On-Flash Partition Tables
------------------------------------

System designers use a variety of on-flash data structures to describe the
layout of the flash. Because it's not always optimal for system software to
scan for every sort of data structure that might be used, one can specify which
structure(s) might be used on a given flash using the 'partitions' subnode of
the flash node.

Node name: partitions
Properties:
 - compatible: (required) used to define which partition format(s) may be in
   use on this flash may contain one or more of the strings defined in the
   following subsections


Google's FMAP (Flash MAP)
#########################

Often used to describe the boot flash on Chrome OS devices. Specified here:

  https://github.com/dhendrix/flashmap/blob/wiki/FmapSpec.md

Properties:
- compatible: (required) must include "google,fmap"


Examples:

flash@0 {
	partitions {
		compatible = "google,fmap";
	};
};
```

## Documentation/devicetree/bindings/mtd/sunxi-nand.txt
```
Allwinner NAND Flash Controller (NFC)

Required properties:
- compatible : "allwinner,sun4i-nfc".
- reg : shall contain registers location and length for data and reg.
- interrupts : shall define the NFC interrupt.
- #address-cells: shall be set to 1. Encode the nand CS.
- #size-cells : shall be set to 0.
- clocks : shall reference NFC clocks.
- clock-names : NFC internal clock names. Shall contain :
    * "ahb_clk" : AHB gating clock
    * "sclk" : NFC clock

Optional children nodes:
Children nodes represent the available nand chips.

Required properties:
- reg : shall contain the CS ids (a given chip might use several CS)
- tCLS-min : see Documentation/devicetree/mtd/nand.txt
- tCLH-min : Documentation/devicetree/mtd/nand.txt
- tCS-min : see Documentation/devicetree/mtd/nand.txt
- tCH-min : see Documentation/devicetree/mtd/nand.txt
- tWP-min : see Documentation/devicetree/mtd/nand.txt
- tWH-min : see Documentation/devicetree/mtd/nand.txt
- tALS-min : see Documentation/devicetree/mtd/nand.txt
- tDS-min : see Documentation/devicetree/mtd/nand.txt
- tDH-min : see Documentation/devicetree/mtd/nand.txt
- tRR-min : see Documentation/devicetree/mtd/nand.txt
- tALH-min : see Documentation/devicetree/mtd/nand.txt
- tRP-min : see Documentation/devicetree/mtd/nand.txt
- tREH-min : see Documentation/devicetree/mtd/nand.txt
- tRC-min : see Documentation/devicetree/mtd/nand.txt
- tWC-min : see Documentation/devicetree/mtd/nand.txt

Optional properties:
- allwinner,rb : shall contain the native Ready/Busy ids.
 or
- rb-gpios : shall contain the gpios used as R/B pins.

see Documentation/devicetree/mtd/nand.txt for generic bindings.


Examples:
nfc: nand@01c03000 {
	pinctrl-names = "default";
	pinctrl-0 = <&nand_pins_a &nand_cs0_pins_a &nand_rb0_pins_a>;
	status = "okay";

	nand@0 {
		reg = <0>;
		allwinner,rb = <0>;
		nand-ecc-mode = "soft_bch";

		/* nand timings */
		tCLS-min = <6>;
		tCLH-min = <3>;
		tCS-min = <20>;
		tCH-min = <5>;
		tWP-min = <8>;
		tWH-min = <6>;
		tALS-min = <6>;
		tDS-min = <6>;
		tDH-min = <2>;
		tRR-min = <20>;
		tALH-min = <3>;
		tRP-min = <8>;
		tREH-min = <6>;
		tRC-min = <16>;
		tWC-min = <16>;
	};
};
```

## Documentation/devicetree/bindings/net/allwinner,sun7i-gmac.txt
```
* Allwinner GMAC ethernet controller

This device is a platform glue layer for stmmac.
Please see stmmac.txt for the other unchanged properties.

Required properties:
 - compatible:  Should be "allwinner,sun7i-gmac"
 - reg: Address and length of register set for the device and corresponding
   clock control

Examples:

	gmac: ethernet@01c50000 {
		compatible = "allwinner,sun7i-gmac";
		reg = <0x01c50000 0x10000>,
		      <0x01c20164 0x4>;
		interrupts = <0 85 1>;
		interrupt-names = "macirq";
		clocks = <&ahb_gates 49>;
		clock-names = "stmmaceth";
		phy-mode = "mii";
	};
```

## arch/arm/configs/sunxi_full_defconfig
```kconfig
CONFIG_SYSVIPC=y
CONFIG_BSD_PROCESS_ACCT=y
CONFIG_IKCONFIG=y
CONFIG_IKCONFIG_PROC=y
CONFIG_BLK_DEV_INITRD=y
CONFIG_INITRAMFS_SOURCE="/home/emilio/buildroot/output/images/rootfs.cpio"
CONFIG_RD_LZO=y
CONFIG_INITRAMFS_COMPRESSION_LZO=y
CONFIG_EMBEDDED=y
CONFIG_JUMP_LABEL=y
CONFIG_PARTITION_ADVANCED=y
CONFIG_ARCH_SUNXI=y
CONFIG_AEABI=y
# CONFIG_OABI_COMPAT is not set
CONFIG_CPU_FREQ=y
CONFIG_CPU_FREQ_DEFAULT_GOV_ONDEMAND=y
CONFIG_VFP=y
CONFIG_NEON=y
CONFIG_NET=y
CONFIG_PACKET=y
CONFIG_INET=y
CONFIG_DEVTMPFS=y
CONFIG_EEPROM_AT24=y
CONFIG_EEPROM_SUNXI_SID=y
CONFIG_NETDEVICES=y
CONFIG_SUN4I_EMAC=y
# CONFIG_WLAN is not set
CONFIG_SERIAL_8250=y
CONFIG_SERIAL_8250_CONSOLE=y
CONFIG_SERIAL_8250_NR_UARTS=8
CONFIG_SERIAL_8250_RUNTIME_UARTS=8
CONFIG_SERIAL_8250_DW=y
CONFIG_I2C=y
CONFIG_I2C_CHARDEV=y
CONFIG_I2C_MV64XXX=y
CONFIG_WATCHDOG=y
CONFIG_SUNXI_WATCHDOG=y
CONFIG_NEW_LEDS=y
CONFIG_LEDS_CLASS=y
CONFIG_LEDS_GPIO=y
CONFIG_LEDS_TRIGGERS=y
CONFIG_LEDS_TRIGGER_HEARTBEAT=y
CONFIG_COMMON_CLK_DEBUG=y
CONFIG_DEBUG_LL=y
CONFIG_EARLY_PRINTK=y
```

## drivers/mtd/partitions/Kconfig
```kconfig
config MTD_REDBOOT_PARTS
	tristate "RedBoot partition table parsing"
	---help---
	  RedBoot is a ROM monitor and bootloader which deals with multiple
	  'images' in flash devices by putting a table one of the erase
	  blocks on the device, similar to a partition table, which gives
	  the offsets, lengths and names of all the images stored in the
	  flash.

	  If you need code which can detect and parse this table, and register
	  MTD 'partitions' corresponding to each image in the table, enable
	  this option.

	  You will still need the parsing functions to be called by the driver
	  for your particular device. It won't happen automatically. The
	  SA1100 map driver (CONFIG_MTD_SA1100) has an option for this, for
	  example.

if MTD_REDBOOT_PARTS

config MTD_REDBOOT_DIRECTORY_BLOCK
	int "Location of RedBoot partition table"
	default "-1"
	---help---
	  This option is the Linux counterpart to the
	  CYGNUM_REDBOOT_FIS_DIRECTORY_BLOCK RedBoot compile time
	  option.

	  The option specifies which Flash sectors holds the RedBoot
	  partition table.  A zero or positive value gives an absolute
	  erase block number. A negative value specifies a number of
	  sectors before the end of the device.

	  For example "2" means block number 2, "-1" means the last
	  block and "-2" means the penultimate block.

config MTD_REDBOOT_PARTS_UNALLOCATED
	bool "Include unallocated flash regions"
	help
	  If you need to register each unallocated flash region as a MTD
	  'partition', enable this option.

config MTD_REDBOOT_PARTS_READONLY
	bool "Force read-only for RedBoot system images"
	help
	  If you need to force read-only for 'RedBoot', 'RedBoot Config' and
	  'FIS directory' images, enable this option.

endif # MTD_REDBOOT_PARTS

config MTD_CMDLINE_PARTS
	tristate "Command line partition table parsing"
	depends on MTD
	---help---
	  Allow generic configuration of the MTD partition tables via the kernel
	  command line. Multiple flash resources are supported for hardware where
	  different kinds of flash memory are available.

	  You will still need the parsing functions to be called by the driver
	  for your particular device. It won't happen automatically. The
	  SA1100 map driver (CONFIG_MTD_SA1100) has an option for this, for
	  example.

	  The format for the command line is as follows:

	  mtdparts=<mtddef>[;<mtddef]
	  <mtddef>  := <mtd-id>:<partdef>[,<partdef>]
	  <partdef> := <size>[@offset][<name>][ro]
	  <mtd-id>  := unique id used in mapping driver/device
	  <size>    := standard linux memsize OR "-" to denote all
	  remaining space
	  <name>    := (NAME)

	  Due to the way Linux handles the command line, no spaces are
	  allowed in the partition definition, including mtd id's and partition
	  names.

	  Examples:

	  1 flash resource (mtd-id "sa1100"), with 1 single writable partition:
	  mtdparts=sa1100:-

	  Same flash, but 2 named partitions, the first one being read-only:
	  mtdparts=sa1100:256k(ARMboot)ro,-(root)

	  If unsure, say 'N'.

config MTD_AFS_PARTS
	tristate "ARM Firmware Suite partition parsing"
	depends on (ARM || ARM64)
	---help---
	  The ARM Firmware Suite allows the user to divide flash devices into
	  multiple 'images'. Each such image has a header containing its name
	  and offset/size etc.

	  If you need code which can detect and parse these tables, and
	  register MTD 'partitions' corresponding to each image detected,
	  enable this option.

	  You will still need the parsing functions to be called by the driver
	  for your particular device. It won't happen automatically. The
	  'physmap' map driver (CONFIG_MTD_PHYSMAP) does this, for example.

config MTD_OF_PARTS
	tristate "OpenFirmware partitioning information support"
	default y
	depends on OF
	help
	  This provides a partition parsing function which derives
	  the partition map from the children of the flash node,
	  as described in Documentation/devicetree/bindings/mtd/partition.txt.

config MTD_AR7_PARTS
	tristate "TI AR7 partitioning support"
	---help---
	  TI AR7 partitioning support

config MTD_BCM63XX_PARTS
	tristate "BCM63XX CFE partitioning support"
	depends on BCM63XX
	select CRC32
	help
	  This provides partions parsing for BCM63xx devices with CFE
	  bootloaders.

config MTD_BCM47XX_PARTS
	tristate "BCM47XX partitioning support"
	depends on BCM47XX || ARCH_BCM_5301X
	help
	  This provides partitions parser for devices based on BCM47xx
	  boards.

config MTD_GOOGLE_FMAP_PARTS
	tristate "Google's Flash Map (FMAP) partition support"
	help
	  This provides partition parsing for Google's flash map layout, used
	  primarily on the boot flash of Chrome OS hardware (e.g., Chromebooks
	  and Chromeboxes).
```

## drivers/video/sunxi/Kconfig
```kconfig
menu "Display options for sun4i/sun5i"
	depends on FB
	depends on PLAT_SUNXI

config LYCHEE_FB_SUN4I
	tristate
	select FB_SUNXI
        depends on FB && ARCH_SUN4I

config LYCHEE_FB_SUN5I
	tristate
	select FB_SUNXI
        depends on FB && ARCH_SUN5I

config FB_SUNXI
	tristate "DISP Driver Support (sun[45]i)"
	depends on FB && PLAT_SUNXI && (ARCH_SUN5I || ARCH_SUN4I)
	select FB_SUNXI_RESERVED_MEM if MALI
	select FB_MODE_HELPERS
	select FB_CFB_FILLRECT
	select FB_CFB_COPYAREA
	select FB_CFB_IMAGEBLIT
	default m

config FB_SUNXI_RESERVED_MEM
	bool "Reserve memory block for sunxi/fb"
	depends on FB_SUNXI
	default y

config FB_SUNXI_UMP
	bool "Enable FB/UMP Integration"
	depends on MALI && FB_SUNXI
	default y

config LYCHEE_LCD_SUN4I
	tristate
	select FB_SUNXI_LCD
        depends on LYCHEE_FB_SUN4I

config LYCHEE_LCD_SUN5I
	tristate
	select FB_SUNXI_LCD
        depends on LYCHEE_FB_SUN5I

config FB_SUNXI_LCD
	tristate "LCD Driver Support(sun[45]i)"
	depends on FB_SUNXI
	default m

config LYCHEE_HDMI_SUN4I
	tristate
	select FB_SUNXI_HDMI
        depends on LYCHEE_LCD_SUN4I

config LYCHEE_HDMI_SUN5I
	tristate
	select FB_SUNXI_HDMI
        depends on LYCHEE_LCD_SUN5I

config FB_SUNXI_HDMI
	tristate "HDMI Driver Support(sun[45]i)"
	depends on FB_SUNXI_LCD
        default m
endmenu
```
